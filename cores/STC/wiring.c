#include "Arduino.h"
#include "stc_sfr.h"

/*
 * Timer0 supplies the Arduino time base. STC89 uses a 12T timer; all other
 * selected families expose the 1T timer clock. One millisecond always fits
 * in the 16-bit counter for the clock choices generated by this platform.
 */
#ifndef STC_TIMER0_CLOCK_DIVIDER
# if STC_CORE_TIMER1_IS_1T
#  define STC_TIMER0_CLOCK_DIVIDER 1UL
# else
#  define STC_TIMER0_CLOCK_DIVIDER 12UL
# endif
#endif

#if (STC_TIMER0_CLOCK_DIVIDER != 1UL) && \
    (STC_TIMER0_CLOCK_DIVIDER != 6UL) && \
    (STC_TIMER0_CLOCK_DIVIDER != 12UL)
# error "STC_TIMER0_CLOCK_DIVIDER must be 1, 6, or 12"
#endif

#define STC_TIMER0_TICKS_PER_MS \
    ((F_CPU + (STC_TIMER0_CLOCK_DIVIDER * 500UL)) / \
     (STC_TIMER0_CLOCK_DIVIDER * 1000UL))
#define STC_TIMER0_RELOAD (65536UL - STC_TIMER0_TICKS_PER_MS)

#if (STC_TIMER0_TICKS_PER_MS < 1UL) || (STC_TIMER0_TICKS_PER_MS > 65535UL)
# error "F_CPU cannot produce a 1 ms Timer0 tick"
#endif

volatile unsigned long stc_timer0_millis_count;

static void stc_timer0_load(void)
{
    TH0 = (uint8_t)(STC_TIMER0_RELOAD >> 8);
    TL0 = (uint8_t)STC_TIMER0_RELOAD;
}

void stc_timer0_isr(void) __interrupt (1)
{
#if !STC_CORE_HAS_TIMER01_16BIT_AUTO_RELOAD
    /* Mode 1 has no hardware reload on STC89/STC12. */
    stc_timer0_load();
#endif
    TCON &= (uint8_t)~STC_TCON_TF0;
    ++stc_timer0_millis_count;
}

void init(void)
{
#if STC_CORE_PINMUX_PSWX1_BIT0_CLEAR
    uint8_t saved_p_sw2 = P_SW2;

    /* Keep the shared P1.2/P5.4 package pad on the variant's P5.4 route. */
    P_SW2 = saved_p_sw2 | 0x80u;
    STC_P_SWX1 &= (uint8_t)~0x01u;
    P_SW2 = saved_p_sw2;
#endif

    TCON &= (uint8_t)~STC_TCON_TR0;

#if STC_CORE_HAS_TIMER01_16BIT_AUTO_RELOAD
    /* STC mode 0: 16-bit auto reload. */
    TMOD &= 0xf0u;
#else
    /* Classic mode 1: 16-bit timer, reloaded by the ISR. */
    TMOD = (TMOD & 0xf0u) | 0x01u;
#endif

#if !defined(STC_CORE_FAMILY_89)
# if STC_TIMER0_CLOCK_DIVIDER == 1UL
    AUXR |= STC_AUXR_T0_1T;
# elif STC_TIMER0_CLOCK_DIVIDER == 12UL
    AUXR &= (uint8_t)~STC_AUXR_T0_1T;
# else
#  error "Only STC89 supports the documented 6T compatibility override"
# endif
#endif

    stc_timer0_millis_count = 0UL;
    stc_timer0_load();
    TCON &= (uint8_t)~STC_TCON_TF0;
    IE |= (STC_IE_ET0 | STC_IE_EA);
    TCON |= STC_TCON_TR0;
}

void yield(void)
{
}

void interrupts(void)
{
    IE |= STC_IE_EA;
}

void noInterrupts(void)
{
    IE &= (uint8_t)~STC_IE_EA;
}

unsigned long millis(void)
{
    uint8_t enabled = IE & STC_IE_EA;
    unsigned long value;

    IE &= (uint8_t)~STC_IE_EA;
    value = stc_timer0_millis_count;
    if ((TCON & STC_TCON_TF0) != 0u) {
        ++value;
    }
    if (enabled != 0u) {
        IE |= STC_IE_EA;
    }
    return value;
}

void delay(unsigned long milliseconds)
{
    unsigned long start = millis();

    while ((unsigned long)(millis() - start) < milliseconds) {
        yield();
    }
}
